## conf/layer.conf
```bitbake
# We have a conf and classes directory, add to BBPATH
BBPATH .= ":${LAYERDIR}"

# We have recipes-* directories, add to BBFILES
BBFILES += "${LAYERDIR}/recipes-*/*/*.bb \
            ${LAYERDIR}/recipes-*/*/*.bbappend"

BBFILE_COLLECTIONS += "meta-vmc-ethernet"
BBFILE_PATTERN_meta-vmc-ethernet = "^${LAYERDIR}/"
BBFILE_PRIORITY_meta-vmc-ethernet = "6"

LAYERDEPENDS_meta-vmc-ethernet = "core"
LAYERSERIES_COMPAT_meta-vmc-ethernet = "walnascar"
```
